#include <Wire.h>                      //IIC通讯头文件
#include <Adafruit_PWMServoDriver.h> //16路舵机控制板头文件
//以这种方式调用，它使用默认地址0x40。
Adafruit_PWMServoDriver pwm = Adafruit_PWMServoDriver();
#define SERVOMIN  680   //这是“最小”高电平占空比计数（在4096中）
#define SERVOMAX  2200   //这是“最大”高电平占空比计数（在4096中）
//前后扭身步态帧数据
char wk[20][8]= {
42,42,-42,-42,-16,-16,16,16,
39,39,-45,-45,-9,-9,24,24,
36,36,-47,-47,-1,-1,30,30,
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45,45,-39,-39,-24,-24,9,9
};
//左右扭身步态帧数据
char wk1[20][8]= {
42,42,-42,-42,-16,-16,16,16,
39,45,-45,-39,-9,-24,24,9,
36,47,-47,-36,-1,-30,30,1,
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45,42,-39,-42,-24,-16,9,16
};
//舵机校准偏角数据
char cal[16]={-6,-14,7,0,0,0,0,0,1,9,-3,3,6,-6,7,-6};
//舵机旋转方向
int8_t rotationDirections[] = {1, -1, 1, 1,
                               1, -1, 1, -1,
                               1, -1, -1, 1,
                               -1, 1, 1, -1
                              };
//关节映射表
byte pins[] = {4, 3, 11, 12,
               5, 2, 13, 10,
               6, 1, 14, 9,
               7, 0, 15, 8
              };
//将角度数据转换成高电平占空比
int S2P(int angle){
  float p=0.0;
  p=(1520/150)*angle+680+760;
  return int(p);
}

void setup() {
   Serial.begin(57600);//打开串口
   pwm.begin();       //初始化PCA9685
   pwm.setPWMFreq(240);  //设置频率60Hz  
}

void loop() {
  //前后扭动
  //循环两次前后扭动
  for(int i=0;i<=19;i++)//一共20帧
  {
    for(int j=0;j<=7;j++)//每帧8个舵机角度
    {      
      Serial.print(int(wk[i][j]));
      //具体舵机角度=步态帧中舵机角度数据*旋转方向+舵机校准偏角+75
      //每次从8号关节舵机开始，执行到16号关节舵机，为一帧
      pwm.setPWM(pins[8+j],0,S2P((int(wk[i][j])+cal[8+j])*rotationDirections[j+8]));
      Serial.print(',');
    }
    delay(50);
    Serial.println();
  }
  for(int i=0;i<=19;i++)//一共20帧
  {
    for(int j=0;j<=7;j++)//每帧8个舵机角度
    {      
      Serial.print(int(wk[i][j]));
      //具体舵机角度=步态帧中舵机角度数据*旋转方向+舵机校准偏角+75
      //每次从8号关节舵机开始，执行到16号关节舵机，为一帧
      pwm.setPWM(pins[8+j],0,S2P((int(wk[i][j])+cal[8+j])*rotationDirections[j+8]));
      Serial.print(',');
    }
    delay(50);
    Serial.println();
  }


  //左右扭动
  //循环两次左右扭动
  for(int i=0;i<=19;i++)//一共20帧
  {
    for(int j=0;j<=7;j++)//每帧8个舵机角度
    {      
      Serial.print(int(wk1[i][j]));
      //具体舵机角度=步态帧中舵机角度数据*旋转方向+舵机校准偏角+75
      //每次从8号关节舵机开始，执行到16号关节舵机，为一帧
      pwm.setPWM(pins[8+j],0,S2P((int(wk1[i][j])+cal[8+j])*rotationDirections[j+8]));
      Serial.print(',');
    }
    delay(50);
    Serial.println();
  }
   for(int i=0;i<=19;i++)//一共20帧
  {
    for(int j=0;j<=7;j++)//每帧8个舵机角度
    {      
      Serial.print(int(wk1[i][j]));
      //具体舵机角度=步态帧中舵机角度数据*旋转方向+舵机校准偏角+75
      //每次从8号关节舵机开始，执行到16号关节舵机，为一帧
      pwm.setPWM(pins[8+j],0,S2P((int(wk1[i][j])+cal[8+j])*rotationDirections[j+8]));
      Serial.print(',');
    }
    delay(50);
    Serial.println();
  }
  //delay(500000000);//只执行一次，如果想循环执行，则需要将此行注释掉
}
