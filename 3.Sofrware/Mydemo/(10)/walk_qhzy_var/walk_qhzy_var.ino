#include <Wire.h>                      //IIC通讯头文件
#include <Adafruit_PWMServoDriver.h> //16路舵机控制板头文件
//以这种方式调用，它使用默认地址0x40。
Adafruit_PWMServoDriver pwm = Adafruit_PWMServoDriver();
#define SERVOMIN  680   //这是“最小”高电平占空比计数（在4096中）
#define SERVOMAX  2200   //这是“最大”高电平占空比计数（在4096中）
//前进步态帧数据
char wk[43][8]= {
 12, 59,-55,-49, 23, 24, -2,-12,
 15, 59,-63,-47, 22, 27, -8,-11,
 18, 59,-67,-45, 20, 30,-20,-11,
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 12, 58,-47,-50, 23, 22,  0,-13,
};
//后退步态帧数据
char bk[45][8]={
 30, 39,-57,-64,  6, -9, -6,  9,
 28, 49,-58,-56,  7,-11, -7, 11,
 25, 58,-59,-47,  9,-10, -9, 11,
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 31, 37,-56,-65,  6, -8, -6,  8,
};
//左转步态帧数据
char wkL[43][8]{
 40, 59,-55,-51,  8, 24, -2, -9,
 41, 59,-63,-50,  8, 27, -8, -9,
 42, 59,-67,-49,  7, 30,-20, -8,
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 40, 58,-47,-51,  8, 22,  0, -9,
};
//右转步态帧数据
char wkR[43][8]={
 12, 55,-53,-49, 23, 12, -5,-12,
 15, 55,-55,-47, 22, 12, -7,-11,
 18, 56,-58,-45, 20, 13, -9,-11,
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 12, 54,-50,-50, 23, 11, -5,-13,
};
char balance[16]= { 
  0,  0,  0,  0,  0,  0,  0,  0, 30, 30,-30,-30, 30, 30,-30,-30};

//舵机校准偏角数据
char cal[16]={-6,-14,7,0,0,0,0,0,1,9,-3,3,6,-6,7,-6};
//舵机旋转方向
int8_t rotationDirections[] = {1, -1, 1, 1,
                               1, -1, 1, -1,
                               1, -1, -1, 1,
                               -1, 1, 1, -1
                              };
//关节映射表
byte pins[] = {4, 3, 11, 12,
               5, 2, 13, 10,
               6, 1, 14, 9,
               7, 0, 15, 8
              };
//将角度数据转换成高电平占空比
int S2P(int angle){
  float p=0.0;
  p=(1520/150)*angle+760+680;
    Serial.print(p);
    Serial.print(",");
  return int(p);
}

void balan(){
  for(int i=0;i<=15;i++)
  {
    Serial.print(i);
    Serial.print(":");
    pwm.setPWM(pins[i],0,S2P((int(balance[i])+cal[i])*rotationDirections[i]));
  }
  delay(500);
}

void setup() {
   Serial.begin(57600);//打开串口
   pwm.begin();       //初始化PCA9685
   pwm.setPWMFreq(240);  //设置频率60Hz  
   balan();
}

void loop() {
  //循环一次前进步态
  for(int i=0;i<=42;i++)//一共43帧
  {
    for(int j=0;j<=7;j++)//每帧8个舵机角度
    {      
      Serial.print(int(wk[i][j]));
      //具体舵机角度=步态帧中舵机角度数据*旋转方向+舵机校准偏角+90
      //每次从8号关节舵机开始，执行到16号关节舵机，为一帧
      pwm.setPWM(pins[8+j],0,S2P((int(wk[i][j])+cal[8+j])*rotationDirections[j+8]));
      Serial.print(',');
    }
    delay(50);
    Serial.println();
  }
  delay(1000);
  balan();
  //循环一次后退步态
  for(int i=0;i<=44;i++)//一共45帧
  {
    for(int j=0;j<=7;j++)//每帧8个舵机角度
    {      
      Serial.print(int(bk[i][j]));
      //具体舵机角度=步态帧中舵机角度数据*旋转方向+舵机校准偏角+90
      //每次从8号关节舵机开始，执行到16号关节舵机，为一帧
      pwm.setPWM(pins[8+j],0,S2P((int(bk[i][j])+cal[8+j])*rotationDirections[j+8]));
      Serial.print(',');
    }
    delay(50);
    Serial.println();
  }
  delay(1000);
  balan();
  //循环一次左转步态
  for(int i=0;i<=42;i++)//一共43帧
  {
    for(int j=0;j<=7;j++)//每帧8个舵机角度
    {      
      Serial.print(int(wkL[i][j]));
      //具体舵机角度=步态帧中舵机角度数据*旋转方向+舵机校准偏角+90
      //每次从8号关节舵机开始，执行到16号关节舵机，为一帧
      pwm.setPWM(pins[8+j],0,S2P((int(wkL[i][j])+cal[8+j])*rotationDirections[j+8]));
      Serial.print(',');
    }
    delay(50);
    Serial.println();
  }
  delay(1000);
  balan();
  //循环一次右转步态
  for(int i=0;i<=42;i++)//一共43帧
  {
    for(int j=0;j<=7;j++)//每帧8个舵机角度
    {      
      Serial.print(int(wkR[i][j]));
      //具体舵机角度=步态帧中舵机角度数据*旋转方向+舵机校准偏角+90
      //每次从8号关节舵机开始，执行到16号关节舵机，为一帧
      pwm.setPWM(pins[8+j],0,S2P((int(wkR[i][j])+cal[8+j])*rotationDirections[j+8]));
      Serial.print(',');
    }
    delay(50);
    Serial.println();
  }
  delay(1000);
  balan();
  //delay(500000000000);//只执行一次，如果想循环执行，则需要将此行注释掉
}
