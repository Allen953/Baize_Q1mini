#include <Wire.h>                      //IIC通讯头文件
#include <Adafruit_PWMServoDriver.h> //16路舵机控制板头文件
//以这种方式调用，它使用默认地址0x40。
Adafruit_PWMServoDriver pwm = Adafruit_PWMServoDriver();
#define SERVOMIN  680   //这是“最小”高电平占空比计数（在4096中）
#define SERVOMAX  2200   //这是“最大”高电平占空比计数（在4096中）

#define VCC 8  //定义8号IO口为VCC（电源）
#define Trig 9 //定义9号IO口连接Trig
#define Echo 10 //定义10号IO口连接Echo

//前进步态帧数据
char wk[36][8]= {
22,-29,18,-22,28,84,-62,-29,
22,-22,13,-22,25,72,-55,-30,
21,-17,9,-21,24,65,-50,-31,
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20,-18,29,-20,29,62,-84,-28
};
//右转舵机角度数据
char yzd[36][8]= {
22,22,-24,-22,28,28,-24,-29,
22,22,-25,-22,25,28,-22,-30,
21,22,-25,-21,24,28,-21,-31,
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20,24,-22,-20,29,24,-28,-28
  };
//左转舵机角度数据
char zzd[36][8]= {
22,-29,18,-22,28,84,-62,-28,
24,-22,13,-24,24,72,-55,-28,
25,-17,9,-25,22,65,-50,-28,
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22,-18,29,-22,28,62,-84,-28
  };
//舵机校准偏角数据
char cal[16]={-6,-14,7,0,0,0,0,0,1,9,-3,3,6,-6,7,-6};
//舵机旋转方向
int8_t rotationDirections[] = {1, -1, 1, 1,
                               1, -1, 1, -1,
                               1, -1, -1, 1,
                               -1, 1, 1, -1
                              };
//balance的姿势                              
char balance[16]= { 
  0,  0,  0,  0,  0,  0,  0,  0, 30, 30,-30,-30, 30, 30,-30,-30};

//关节映射表
byte pins[] = {4, 3, 11, 12,
               5, 2, 13, 10,
               6, 1, 14, 9,
               7, 0, 15, 8
              };
//将角度数据转换成高电平占空比
int S2P(int angle){
  float p=0.0;
  p=(1520/150)*angle+680+760;
  return int(p);
}

void balan(){
  for(byte i=0;i<=15;i++)
    pwm.setPWM(pins[i],0,S2P((int(balance[i])+cal[i])*rotationDirections[i]));
  delay(500);
}
//前进函数，ste为走的步数
void qj(byte ste=1){
  for(int k=0;k<ste;k++)
  {
  //循环一次前进步态
  for(int i=0;i<=35;i++)//一共35帧
  {
    for(int j=0;j<=7;j++)//每帧8个舵机角度
    {      
      Serial.print(int(wk[i][j]));
      //具体舵机角度=步态帧中舵机角度数据*旋转方向+舵机校准偏角+75
      //每次从8号关节舵机开始，执行到16号关节舵机，为一帧
      pwm.setPWM(pins[8+j],0,S2P((int(wk[i][j])+cal[8+j])*rotationDirections[j+8]));
      Serial.print(',');
    }
    delay(10);
    Serial.println();
  }
  }
}

//后退函数，ste为走的步数
void ht(byte ste=1){
  for(int k=0;k<ste;k++)
  {
  //循环一次后退步态
  for(int i=0;i<=35;i++)//一共35帧
  {
    for(int j=0;j<=7;j++)//每帧8个舵机角度
    {      
      Serial.print(int(wk[i][j]));
      //具体舵机角度=步态帧中舵机角度数据*旋转方向+舵机校准偏角+75
      //每次从8号关节舵机开始，执行到16号关节舵机，为一帧
      pwm.setPWM(pins[8+j],0,S2P((int(wk[35-i][j])+cal[8+j])*rotationDirections[j+8]));
      Serial.print(',');
    }
    delay(10);
    Serial.println();
  }
  }
}

//右转函数,ste为走的步数
void yz(byte ste=1){
  for(int k=0;k<ste;k++)
  {
  //循环一次后退步态
  for(int i=0;i<=35;i++)//一共35帧
  {
    for(int j=0;j<=7;j++)//每帧8个舵机角度
    {      
      //具体舵机角度=步态帧中舵机角度数据*旋转方向+舵机校准偏角+75
      //每次从8号关节舵机开始，执行到16号关节舵机，为一帧
      pwm.setPWM(pins[8+j],0,S2P((int(yzd[i][j])+cal[8+j])*rotationDirections[j+8]));
    }
    delay(15);
    Serial.println();
  }
  }
}


//左转函数，ste为走的步数
void zz(byte ste=1){
  for(int k=0;k<ste;k++)
  {
  //循环18次左转步态
  for(int i=0;i<=35;i++)//一共35帧
  {
    for(int j=0;j<=7;j++)//每帧8个舵机角度
    {      
      //具体舵机角度=步态帧中舵机角度数据*旋转方向+舵机校准偏角+75
      //每次从8号关节舵机开始，执行到16号关节舵机，为一帧
      pwm.setPWM(pins[8+j],0,S2P((int(zzd[i][j])+cal[8+j])*rotationDirections[j+8]));
    }
    delay(15);
    Serial.println();
  }
  }
}

//向左方避障
void zb()
{
  zz(18);
  delay(500);//停500毫秒
  yz(18);
  delay(500);//停500毫秒
}

//向右方避障
void yb()
{
  yz(18);
  delay(500);//停500毫秒
  zz(18);
  delay(500);//停500毫秒
}


//测距
int dis(){
  float cm; //定义全局变量cm存储距离
  //发一个10ms的高脉冲去触发TrigPin 
  digitalWrite(Trig, LOW); 
  delayMicroseconds(2); 
  digitalWrite(Trig, HIGH); 
  delayMicroseconds(10); 
  digitalWrite(Trig, LOW); 
  //pulseIn函数可以检测出高低电平脉冲宽度
  cm=pulseIn(Echo,HIGH)/58.0; //算成厘米 
  cm=(int(cm * 100.0))/100.0;//保留两位小数 
  Serial.print(cm); 
  Serial.print("cm"); 
  Serial.println(); 
  //delay(100); 
  return int(cm);
}



int dis_prt=0;
void setup() {
   Serial.begin(57600);//打开串口
   pinMode(VCC,OUTPUT); //初始化引脚模式
   digitalWrite(VCC,HIGH); //给模块上电
   pinMode(Trig, OUTPUT); 
   pinMode(Echo, INPUT); 
   pwm.begin();       //初始化PCA9685
   pwm.setPWMFreq(240);  //设置频率240Hz  
   balan();  //起立
   delay(1000);
}

void loop() {
  //障碍距离保持，或者跟随
  dis_prt=dis();
  Serial.println(dis_prt,DEC);
  if(dis_prt>0&&dis_prt<10)
    ht();
  else if(dis_prt>20&&dis_prt<150)
  qj();
  
  //避障
  /*
  dis_prt=dis();
  Serial.println(dis_prt,DEC);
  if(dis_prt>0&&dis_prt<10)
    ht();
  else if(dis_prt>20||dis_prt<0)
  qj();
  else if(dis_prt>10&&dis_prt<20)
  yb();
  */
}
